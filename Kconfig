## Kconfig
```kconfig
#
# Copyright (c) 2020 Laird Connectivity
#
# This code is for use only in projects based around the Laird Connectivity
# Pinnacle 100 module (including PC or embedded device applications). All other
# use of this code is prohibited. All rights reserved.
#
# It is provided "as is", without warranty/guarantee of any kind, express of
# implied, including but not limited to the warranties of merchantability,
# fitness for a particular purpose and non-infringement.
#

if BOARD_PINNACLE_100_DVK || BOARD_MG100

menuconfig HAS_LAIRDCONNECTIVITY
	bool "Laird Connectivity Universal Bootloader support"
	help
	  Enable Laird Connectivity HAL.

if HAS_LAIRDCONNECTIVITY

config LAIRDCONNECTIVITY_UWG
	bool "Enable Uwg Module"
	default y
	help
	  Enable the checksum module.

config LAIRDCONNECTIVITY_MSC
	bool "Enable Msc Module"
	default y
	select LAIRDCONNECTIVITY_UWG
	help
	  Enable the checksum module.

menuconfig LAIRDCONNECTIVITY_BLR
	bool "Enable Blr Module"
	default y
	select LAIRDCONNECTIVITY_UWG
	select LAIRDCONNECTIVITY_MSC
	help
	  Enable the bootloader module.

if LAIRDCONNECTIVITY_BLR

config LAIRDCONNECTIVITY_BLR_SKIP_CHECKSUM_VERIFY
	bool "Skip Bootloader Struct Verification"
	default n
	help
	  Will allow using an unverified bootloader structure.
	  This should *ONLY* be used with a debug bootloader loaded.

endif # LAIRDCONNECTIVITY_BLR

endif # HAS_LAIRDCONNECTIVITY

endif # BOARD_PINNACLE_100_DVK
```
